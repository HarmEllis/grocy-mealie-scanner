## firmware/main/Kconfig.projbuild
```kconfig
menu "Grocy-Mealie scanner"

    config GMS_DEMO_MODE
        bool "Demo mode (no WiFi, no API, canned fixtures)"
        default n
        help
            Build a self-contained demo image. The real HTTP api_client.c is
            replaced by api_client_demo.c, which serves canned product
            fixtures and keeps stock in RAM, so purchase/consume/open show
            realistic before/after numbers without a backend.

            In demo mode boot skips provisioning, WiFi and the API ping and
            goes straight to the idle screen. A short press of the BOOT
            button injects the next scenario in a fixed cycle, so the full
            flow can be shown with no GM67 module and no printed barcode.
            A real GM67 scan still works: any barcode resolves to a fixture
            (known demo codes) or a generated product (everything else).

            Leave this off for production firmware that talks to
            grocy-mealie-sync.

    config GMS_OTA_CHECK_INTERVAL_HOURS
        int "OTA update check interval (hours)"
        default 24
        range 1 168
        depends on !GMS_DEMO_MODE
        help
            How often the firmware polls GitHub Releases for a newer signed
            image. A first check also runs a few seconds after boot, once
            WiFi and SNTP have settled.

            GitHub's unauthenticated API is rate-limited to 60 requests per
            hour per public IP, so keep this generous. The default of 24 h is
            plenty for a home appliance; lower it only for testing.

    config GMS_WIFI_COUNTRY
        string "Default WiFi country code (regulatory domain)"
        default "01"
        help
            Two-letter ISO country code applied via esp_wifi_set_country_code()
            with 802.11d enabled, so the device also adapts to the AP's
            advertised domain.

            "01" is the world-safe default and ships legally anywhere, but it
            makes channels 12-13 passive-only: a router on auto-channel that
            lands on 13 is then only reachable passively and can show up as
            repeated auth failures. Set a concrete region (e.g. "NL") to enable
            channels 1-13 for active scan.

endmenu
```

## firmware/sdkconfig.defaults
```kconfig
# Flash: FNK0104AB ships a 16 MB 25VQ128.
CONFIG_ESPTOOLPY_FLASHSIZE_16MB=y

# PSRAM: ESP32-S3R8 = 8 MB octal PSRAM. LVGL draw buffers and the larger
# JSON/scan buffers live here.
CONFIG_SPIRAM=y
CONFIG_SPIRAM_MODE_OCT=y
CONFIG_SPIRAM_SPEED_80M=y

# Partition layout: custom 2-slot OTA CSV (firmware/partitions.csv), 3 MB
# per slot on the 16 MB flash.
CONFIG_PARTITION_TABLE_CUSTOM=y
CONFIG_PARTITION_TABLE_CUSTOM_FILENAME="partitions.csv"

# OTA download path: bundled Mozilla root CAs so esp_https_ota can validate
# github.com / objects.githubusercontent.com without shipping a per-host PEM.
CONFIG_MBEDTLS_CERTIFICATE_BUNDLE=y

# Allow the API client's optional "trust any certificate" mode (settings/portal).
# With no CA configured, esp-tls then sets MBEDTLS_SSL_VERIFY_NONE instead of
# failing the handshake. API only: OTA always attaches the strict bundle above,
# so it keeps verifying regardless of this option.
CONFIG_ESP_TLS_INSECURE=y
CONFIG_ESP_TLS_SKIP_SERVER_CERT_VERIFY=y

# OTA update authenticity without burning eFuses. Apps are signed with an
# RSA-3072 Secure Boot V2 signature block, and OTA updates are verified against
# the public-key digest from the currently running signed app. This protects
# against remote spoofed updates, but not physical reflashing.
CONFIG_SECURE_SIGNED_APPS_NO_SECURE_BOOT=y
CONFIG_SECURE_SIGNED_ON_UPDATE_NO_SECURE_BOOT=y
CONFIG_SECURE_BOOT_BUILD_SIGNED_BINARIES=y
CONFIG_SECURE_BOOT_SIGNING_KEY="secure_boot_signing_key.pem"
# CONFIG_SECURE_BOOT is not set

# Mark a newly OTA-installed image as PENDING_VERIFY at boot; firmware calls
# esp_ota_mark_app_valid_cancel_rollback() once a scan→render cycle succeeds.
CONFIG_BOOTLOADER_APP_ROLLBACK_ENABLE=y

# app_main runs WiFi setup, the app event loop, HTTP + JSON parsing.
CONFIG_ESP_MAIN_TASK_STACK_SIZE=8192

# WiFi
CONFIG_ESP_WIFI_SOFTAP_SUPPORT=y

# USB-Serial-JTAG CDC as secondary log console (UART0 stays primary).
CONFIG_ESP_CONSOLE_SECONDARY_USB_SERIAL_JTAG=y

# NVS encryption off (home LAN use case)
CONFIG_NVS_ENCRYPTION=n

# SoftAP compatibility (ESP32-S3): disable AMPDU RX/TX to fix S2/S3 SoftAP
# incompatibility with phones/PCs during provisioning. See ESP-IDF #13508.
CONFIG_ESP_WIFI_AMPDU_TX_ENABLED=n
CONFIG_ESP_WIFI_AMPDU_RX_ENABLED=n

# HTTPD / provisioning portal
CONFIG_HTTPD_MAX_REQ_HDR_LEN=1024

# Task stacks bumped for the SoftAP captive-portal flow (SoftAP + DHCP server
# + captive DNS + httpd all active during provisioning).
CONFIG_LWIP_TCPIP_TASK_STACK_SIZE=5120
CONFIG_ESP_IPC_TASK_STACK_SIZE=4096
CONFIG_ESP_SYSTEM_EVENT_TASK_STACK_SIZE=4096
CONFIG_ESP_TIMER_TASK_STACK_SIZE=4608

# LVGL
CONFIG_LV_CONF_SKIP=y
CONFIG_LV_COLOR_DEPTH_16=y
CONFIG_LV_USE_QRCODE=y
CONFIG_LV_USE_TRANSLATION=y
CONFIG_LV_USE_TINY_TTF=y
CONFIG_LV_FONT_MONTSERRAT_10=y
CONFIG_LV_FONT_MONTSERRAT_12=y
CONFIG_LV_FONT_MONTSERRAT_14=y
CONFIG_LV_FONT_MONTSERRAT_16=y
CONFIG_LV_FONT_MONTSERRAT_18=y
CONFIG_LV_FONT_MONTSERRAT_20=y
CONFIG_LV_FONT_MONTSERRAT_22=y
CONFIG_LV_FONT_MONTSERRAT_24=y

# Default log level INFO; maximum DEBUG so esp_log_level_set() can enable
# per-tag debug output (e.g. "gm67") without flooding the console.
CONFIG_LOG_DEFAULT_LEVEL_INFO=y
CONFIG_LOG_MAXIMUM_LEVEL=4
```
